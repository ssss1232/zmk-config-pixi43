## boards/shields/pixi43/Kconfig.defconfig
```kconfig
if SHIELD_PIXI43_R

config ZMK_KEYBOARD_NAME
    default "pixi43_R"

config ZMK_SPLIT
    default y

config ZMK_SPLIT_ROLE_CENTRAL
    default y

endif

if SHIELD_PIXI43_L

config ZMK_KEYBOARD_NAME
    default "pixi43_L"

config ZMK_SPLIT
    default y

endif
```

## boards/shields/pixi43/Kconfig.shield
```kconfig
config SHIELD_PIXI43_R
    def_bool $(shields_list_contains,pixi43_R)

config SHIELD_PIXI43_L
    def_bool $(shields_list_contains,pixi43_L)
```
